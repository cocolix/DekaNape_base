## boards/shields/DekaNape/Kconfig.defconfig
```kconfig
config ZMK_KEYBOARD_NAME
    default "Deka Nape"

config BT_MAX_CONN
    default 3

# Set this to the same number as BT_MAX_CONN
config BT_MAX_PAIRED
    default 3
```

## config/west.yml
```yaml
manifest:
  remotes:
    - name: zmkfirmware
      url-base: https://github.com/zmkfirmware
    - name: kot149
      url-base: https://github.com/kot149
    - name: badjeff
      url-base: https://github.com/badjeff

  projects:
    - name: zmk
      remote: zmkfirmware
      revision: main
      import: app/west.yml
    - name: zmk-pmw3610-driver
      remote: badjeff
      revision: zmk-0.4
    - name: zmk-mouse-gesture
      remote: kot149
      revision: v1
    - name: zmk-scroll-snap
      remote: kot149
      revision: v1

  self:
    path: config
```
